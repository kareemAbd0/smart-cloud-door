## yocto-image/meta-scd/conf/distro/scdOS.conf
```bitbake
# Distro Layer configuration
# include and overwrite default poky distro
include conf/distro/poky.conf
DISTRO = "scdOS"
DISTRO_NAME = "scdOS"
DISTRO_VERSION = "1.0"


# Use systemd as init manager
INIT_MANAGER = "systemd"
```

## yocto-image/meta-scd/conf/layer.conf
```bitbake
# We have a conf and classes directory, add to BBPATH
BBPATH .= ":${LAYERDIR}"

# We have recipes-* directories, add to BBFILES
BBFILES += "${LAYERDIR}/recipes-*/*/*.bb \
            ${LAYERDIR}/recipes-*/*/*.bbappend"

BBFILE_COLLECTIONS += "meta-scd"
BBFILE_PATTERN_meta-scd = "^${LAYERDIR}/"
BBFILE_PRIORITY_meta-scd = "6"

LAYERDEPENDS_meta-scd = "core"
LAYERSERIES_COMPAT_meta-scd = "kirkstone"
```
